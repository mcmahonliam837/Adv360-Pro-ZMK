macro_tmux4: macro_tmux4{
compatible = "zmk,behavior-macro";
label = "macro_tmux4";
#binding-cells = <0>;
bindings = <&sk LEFT_CONTROL>, <&kp A>, <&kp NUMBER_4>;
};
macro_tmux3: macro_tmux3{
compatible = "zmk,behavior-macro";
label = "macro_tmux3";
#binding-cells = <0>;
bindings = <&sk LEFT_CONTROL>, <&kp A>, <&kp NUMBER_3>;
};
macro_tmux2: macro_tmux2{
compatible = "zmk,behavior-macro";
label = "macro_tmux2";
#binding-cells = <0>;
bindings = <&sk LEFT_CONTROL>, <&kp A>, <&kp NUMBER_2>;
};
macro_tmux1: macro_tmux1{
compatible = "zmk,behavior-macro";
label = "macro_tmux1";
#binding-cells = <0>;
bindings = <&sk LEFT_CONTROL>, <&kp A>, <&kp NUMBER_1>;
};
